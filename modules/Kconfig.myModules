## modules/Kconfig.myModules
```kconfig
rsource "bt/Kconfig.bt_module"
rsource "camera/Kconfig.camera_module"
rsource "common/Kconfig.common"
rsource "fs/Kconfig.fs_module"
rsource "mcu_exchange/Kconfig.mcu_exchange_module"
rsource "mqtt/Kconfig.mqtt_module"
rsource "sensors/Kconfig.sensors_module"
rsource "lodepng/Kconfig.lodepng_module"
rsource "watchdog/Kconfig.watchdog_module"
```

## modules/bt/Kconfig.bt_module
```kconfig
menuconfig BLE_MODULE
	bool "Bluetooth module"

if BLE_MODULE

config BLE_THREAD_STACK_SIZE
	int "Bluetooth module thread stack size"
	default 1536

config BLE_EVENTS_LOG
	bool "Enable logging for Bluetooth module events"
	default y

config BLE_LBS_SECURITY_ENABLED
	bool "Enable security"
	default y
	select BT_SMP
	select BT_SETTINGS
	select FLASH
	select FLASH_PAGE_LAYOUT
	select FLASH_MAP
	select NVS
	select SETTINGS
	help
	  "Enable BLE security for the LED-Button service"

config BLE_ENABLE_CAMERA_SERVICE
	bool "Enable and include the camera service."

config BLE_ENABLE_HEATY_SERVICE
	bool "Enable and include the serial service."

config BLE_ENABLE_TIME_SERVICE
	bool "Enable and include the serial service."

# https://docs.zephyrproject.org/latest/guides/build/kconfig/tips.html
#   A common misunderstanding related to if is to think that the following code conditionally includes the file Kconfig.other:
#   in reality, there are no conditional includes in Kconfig. if has no special meaning around a source.
# if BLE_ENABLE_CAMERA_SERVICE
rsource "../camera/Kconfig.camera_module"
# endif # BLE_ENABLE_CAMERA_SERVICE


endif # BLE_MODULE

module = BLE_MODULE
module-str = Bluetooth module
source "subsys/logging/Kconfig.template.log_config"
```

## modules/camera/Kconfig.camera_module
```kconfig
menuconfig CAMERA_MODULE
	bool "Camers module"

if CAMERA_MODULE

config CAMERA_THREAD_STACK_SIZE
	int "Camers module thread stack size"
	default 1024

config CAMERA_WORK_THREAD_STACK_SIZE
	int "Camers module thread stack size"
	default 4096

config CAMERA_EVENTS_LOG
	bool "Enable logging for Camers module events"
	default y

config ARDUCAM_SPI_USE_ZEPHYR
	bool "Use the zephyr SPI driver"

config ARDUCAM_SPI_USE_NRFX
	bool "Use the nrfx SPI driver"
	select NRFX_SPIM
	select NRFX_SPIM2
	default y

config ARDUCAM_TWI_USE_ZEPHYR
	bool "Use the zephyr TWI driver"
	select I2C

config ARDUCAM_TWI_USE_NRFX
	bool "Use the nrfx TWI driver"
	select NRFX_TWIM
	select NRFX_TWIM0
	default y

config CAMERA_IMAGE_CHUNCK_SIZE
	int "Chunck size when reading image from camera"
	default 10240


endif # CAMERA_MODULE


config CAMERA_DEFAULT_JPEG_SIZE
	int "Default value for the jpeg size according to ArduCAM_regs.h. Default is OV2640_1600x1200"
	default 8

config CAMERA_DEFAULT_LIGHT_MODE
	int "Default value for the light mode according to ArduCAM_regs.h. Default is Auto"
	default 0

config CAMERA_DEFAULT_COLOR_SATURATION
	int "Default value for the jpeg size according to ArduCAM_regs.h. Default is Saturation0"
	default 4

config CAMERA_DEFAULT_BRIGHTNESS
	int "Default value for the jpeg size according to ArduCAM_regs.h. Default is Brightness0"
	default 4

config CAMERA_DEFAULT_CONTRAST
	int "Default value for the jpeg size according to ArduCAM_regs.h. Default is Contrast0"
	default 4

config CAMERA_DEFAULT_SPECIAL_EFFECTS
	int "Default value for the jpeg size according to ArduCAM_regs.h. Default is Normal"
	default 7

config CAMERA_DEFAULT_JPEG_QUALITY
	int "Default value for the jpeg size according to ArduCAM_regs.h. Default is 10"
	default 10

config CAMERA_DEFAULT_CAM_INTERVAL
	int "Camera takes an image every x seconds. Default is 10"
	default 10


module = CAMERA_MODULE
module-str = Camers module
source "subsys/logging/Kconfig.template.log_config"

module = ARDUCAM_MODULE
module-str = Arducam module
source "subsys/logging/Kconfig.template.log_config"
```

## modules/common/Kconfig.common
```kconfig
config WAIT_FOR_SERIAL_ATTACHED
	select UART_LINE_CTRL
	bool "Wait until serial is attached on startup"

config WAIT_FOR_MANUAL_START
	bool "Do not module_set_state(MODULE_STATE_READY) on startup"
		
config MEMFAULT_DEVICE_ID
	string "Device ID used for memfault"
	default "N/A"	

menuconfig HEAP_MEMORY_STATISTICS
	bool "Add hooks to track allocated memory by my_malloc and my_free. Otherwise map to k_*"

if HEAP_MEMORY_STATISTICS

config HEAP_MEMORY_STATISTICS_THREAD
	bool "Periodically check for memory allocations"

config HEAP_MEMORY_STATISTICS_THREAD_TIMEOUT
	int "Check every x seconds for memory allocation"
	default 60

endif # HEAP_MEMORY_STATISTICS

module = MEMORY_STAT
module-str = memory statistics
source "subsys/logging/Kconfig.template.log_config"

module = DIAG
module-str = Diagnostics nrf52840
source "${ZEPHYR_BASE}/subsys/logging/Kconfig.template.log_config"
```

## modules/fs/Kconfig.fs_module
```kconfig
menuconfig FS_MODULE
	bool "fs module"

if FS_MODULE

config FS_THREAD_STACK_SIZE
	int "fs module thread stack size"
	default 2048

config FS_EVENTS_LOG
	bool "Enable logging for fs module events"
	default y

config MAX_PATH_LENGTH
	int "Buffer size for the path string"
	default 20

config FILE_READ_BUFFER_SIZE
	int "Maximum file size that can be read from SD card."
	default 200


endif # FS_MODULE

module = FS_MODULE
module-str = fs module
source "subsys/logging/Kconfig.template.log_config"
```

## modules/lodepng/Kconfig.lodepng_module
```kconfig
menuconfig LODEPNG
	bool "Add support for png encoding. Limited to greyscale 32*24 images due to high memory demand"
```

## modules/mcu_exchange/Kconfig.mcu_exchange_module
```kconfig
menuconfig MCU_EXCHANGE_MODULE
	bool "Mcu Exchange module"

if MCU_EXCHANGE_MODULE

config BLE_NRF9160_BRIDGE_AVAILABLE
	bool "helper config"
	default y if BLE_MODULE

config USB_NRF9160_BRIDGE_AVAILABLE
	bool "helper config"
	default y if USB_CDC_ACM

config MCU_EXCHANGE_THREAD_STACK_SIZE
	int "Mcu Exchange module thread stack size. Consider cJson"
	default 4096

config MCU_EXCHANGE_EVENTS_LOG
	bool "Enable logging for Mcu Exchange module events"
	default y

config MCU_EXCHANGE_UART_BUF_SIZE
	int "Size of the uart buffer for commands"
	default 4096

config MCU_EXCHANGE_UART_INIT_TIMEOUT
	int "Timeout until the uart becomes active"
	default 10

config MCU_EXCHANGE_UART
	string "Label for the Uart device"
	default "UART_1"

endif # MCU_EXCHANGE_MODULE

module = MCU_EXCHANGE_MODULE
module-str = mcu exchange module
source "subsys/logging/Kconfig.template.log_config"
```

## modules/mqtt/Kconfig.mqtt_module
```kconfig
menuconfig MQTT_MODULE
	bool "Mqtt module"

if MQTT_MODULE

config MQTT_THREAD_STACK_SIZE
	int "mqtt module thread stack size"
	default 8192

config MQTT_EVENTS_LOG
	bool "Enable logging for Cloud module events"
	default y

config MQTT_CLIENT_ID
	string "MQTT Client ID"
	default "my-client-id"

config MQTT_BROKER_HOSTNAME
	string "MQTT broker hostname"
	default "mqtt.eclipseprojects.io"

config MQTT_BROKER_PORT
	int "MQTT broker port"
	default 1883

config MQTT_USER_NAME
	string "MQTT user name"
	default "username"

config MQTT_PASSWORD
	string "MQTT password"
	default "password"

config MQTT_TOPIC_TEMPERATURE
	string "MQTT topic for temperature"
	default "topic"

config MQTT_TOPIC_HUMIDITY
	string "MQTT topic for humidity"
	default "topic"

config MQTT_TOPIC_HEATMAP
	string "MQTT topic for heatmap sensor data"
	default "topic"

config MQTT_MESSAGE_BUFFER_SIZE
	int "mqtt module message buffer size"
	default 512

config MQTT_RECONNECT_DELAY_S
	int "Seconds to delay before attempting to reconnect to the broker."
	default 60

config MQTT_TLS_SESSION_CACHING
	bool "Enable TLS session caching"

config MQTT_TLS_PEER_VERIFY
	int "Set peer verification level"
	default 2
	help
		Set to 0 for VERIFY_NONE, 1 for VERIFY_OPTIONAL, and 2 for
		VERIFY_REQUIRED.

endif # MQTT_MODULE

module = MQTT_MODULE
module-str = Mqtt module
source "subsys/logging/Kconfig.template.log_config"
```

## modules/sensors/Kconfig.sensors_module
```kconfig
#
# Copyright (c) 2021 Nordic Semiconductor
#
# SPDX-License-Identifier: LicenseRef-Nordic-5-Clause
#

menuconfig SENSORS_MODULE
	bool "Sensor module"

if SENSORS_MODULE

config SENSORS_THREAD_STACK_SIZE
	int "Sensor module thread stack size"
	default 6144

config SENSORS_EVENTS_LOG
	bool "Enable logging for Cloud module events"
	default y

menuconfig SENSORS_MLX90640
	bool "MLX90640 sensor module"
	select I2C
	default y

if SENSORS_MLX90640

config HEAT_MAP_CYCLE
	int "heat map read cycle"
	default 10
	help
	  Cyclic call to read the env values

config HEAT_MAP_INIT_DELAY
	int "Time until first heat map is read"
	default 20
	help
	  Cyclic call to read the env values

config MLX90640_STACK_SIZE
	int "Stack size for reading sensor task"
	default 5000
	help
	  Stack size for reading sensor task


endif # SENSORS_MLX90640

endif # SENSORS_MODULE

module = SENSORS_MODULE
module-str = Sensor module
source "subsys/logging/Kconfig.template.log_config"
```

## modules/watchdog/Kconfig.watchdog_module
```kconfig
config WATCHDOG_TIMER_MAIN_CHANNEL
	int "Timeout for the main channel watchdog in ms."
	default 2000

config WATCHDOG_TIMER_MCU_COMM_CHANNEL
	int "Timeout for the mcu comm channel watchdog in ms."
	default 10000
```

## nrf52840/src/commCtrl/Kconfig.commCtrl_module
```kconfig
#
# Copyright (c) 2021 Nordic Semiconductor
#
# SPDX-License-Identifier: LicenseRef-Nordic-5-Clause
#

menuconfig COMMCTRL_MODULE
	bool "CommCtrl module"
	default y

if COMMCTRL_MODULE

config COMMCTRL_THREAD_STACK_SIZE
	int "CommCtrl module thread stack size. Consider cJson."
	default 2048

config COMMCTRL_EVENTS_LOG
	bool "Enable logging for CommCtrl module events"
	default y

endif # COMMCTRL_MODULE

module = COMMCTRL_MODULE
module-str = CommCtrl module
source "subsys/logging/Kconfig.template.log_config"
```

## nrf52840/src/commCtrl/bridge/events/Kconfig
```kconfig
#
# Copyright (c) 2020 Nordic Semiconductor
#
# SPDX-License-Identifier: LicenseRef-Nordic-5-Clause
#

if LOG

menu "Event options"

comment "Initially logged events"

config BRIDGE_LOG_UART_DATA_EVENT
	bool "UART data event"

config BRIDGE_LOG_CDC_DATA_EVENT
	bool "CDC data event"

config BRIDGE_LOG_BLE_DATA_EVENT
	bool "BLE data event"

config BRIDGE_LOG_PEER_CONN_EVENT
	bool "Peer connection event"

endmenu

endif
```

## nrf52840/src/commCtrl/bridge/modules/Kconfig
```kconfig
#
# Copyright (c) 2020 Nordic Semiconductor
#
# SPDX-License-Identifier: LicenseRef-Nordic-5-Clause
#

module = BRIDGE_UART
module-str = UART device
source "subsys/logging/Kconfig.template.log_config"

config BRIDGE_CDC_ENABLE
	bool "Enable USB CDC ACM"
	default y
	depends on USB_DEVICE_STACK
	select USB_CDC_ACM
	select GPIO
	select POLL
	help
		This option enables USB CDC ACM
		and exposes two COM ports, bridging the two UART interfaces.

if BRIDGE_CDC_ENABLE

module = BRIDGE_CDC
module-str = USB CDC ACM device
source "subsys/logging/Kconfig.template.log_config"

endif

if PM_DEVICE

module = BRIDGE_POWER_MGMT
module-str = Bridge power management
source "subsys/logging/Kconfig.template.log_config"

endif

config BRIDGE_BUF_SIZE
	int "Transport interface buffer size"
	default 2048
	help
	  Size of transmit/receive buffer for transfer between interfaces.

config BRIDGE_UART_BUF_COUNT
	int "UART buffer block count"
	default 3
	range 3 255
	help
	  Number of buffer blocks assigned for UART instances.
	  This value is scaled with the number of interfaces.
	  With the default instance count of 2, and for example 3 buffers,
	  the total will be 6 buffers.
	  Note that all buffers are shared between UART instances.
```

## nrf9160_ns/src/analysis/Kconfig.analysis_module
```kconfig
menuconfig ANALYSIS_MODULE
	bool "Analysis module"
	default y

if ANALYSIS_MODULE

config ANALYSIS_THREAD_STACK_SIZE
	int "Analysis module thread stack size"
	default 8192

config ANALYSIS_EVENTS_LOG
	bool "Enable logging for Cloud module events"
	default y

config HISTORY_SIZE
	int "Number of kept statistics history"
	default 10

endif # ANALYSIS_MODULE

module = ANALYSIS_MODULE
module-str = Analysis module
source "subsys/logging/Kconfig.template.log_config"
```

## nrf9160_ns/src/sensors/Kconfig.sensors_module
```kconfig
menuconfig SENSORS91_MODULE
	bool "Sensor module"
	default y

if SENSORS91_MODULE

config SENSORS_THREAD_STACK_SIZE
	int "Sensor module thread stack size"
	default 8192

config SENSORS_EVENTS_LOG
	bool "Enable logging for Cloud module events"
	default y

config SENSORS_HIGH_COLOR_INTENSITY_THRESHOLD
	int "Definition of high color intensity to activate the Button event"
	default 300

endif # SENSORS91_MODULE

module = SENSORS91_MODULE
module-str = Sensor module
source "subsys/logging/Kconfig.template.log_config"
```
